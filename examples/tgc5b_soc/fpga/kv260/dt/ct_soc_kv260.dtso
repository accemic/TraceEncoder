// SPDX-FileCopyrightText: 2026 Accemic Technologies GmbH
// SPDX-License-Identifier: CERN-OHL-S-2.0 OR LicenseRef-Accemic-Commercial
//
// Device-tree overlay for the TGC5B + CEDARtools.TraceEncoder KV260 app. Loading it with
// `xmutil loadapp` programs the PL with the bitstream named below. The SoC is
// controlled purely through physical-address reads/writes (devmem) at
// 0xA000_0000, so no kernel driver / device node is required here.
//
// Compile: dtc -@ -I dts -O dtb -o ct_soc_kv260.dtbo ct_soc_kv260.dtso

/dts-v1/;
/plugin/;

&fpga_full {
	firmware-name = "ct_soc_kv260.bit.bin";
};
